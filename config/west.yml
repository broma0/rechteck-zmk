## config/west.yml
```yaml
manifest:
  remotes:
    - name: zmkfirmware
      url-base: https://github.com/zmkfirmware
    - name: boardsource
      url-base: https://github.com/boardsource
  projects:
    - name: zmk
      remote: zmkfirmware
      revision: main
      import: app/west.yml
    - name: Rechtek_zmk_config
      remote: boardsource
      revision: main
  self:
    path: config
```
